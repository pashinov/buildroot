## package/dragon/Config.in
```kconfig
config BR2_PACKAGE_DRAGON
	bool "dragon"
	select BR2_PACKAGE_BOOST
	select BR2_PACKAGE_BOOST_SYSTEM
	select BR2_PACKAGE_ZEROMQ
	select BR2_PACKAGE_OPENSSL
	select BR2_PACKAGE_PROTOBUF
	select BR2_PACKAGE_PROTOBUF_C
	select BR2_PACKAGE_LIBCPPRESTSDK
	help
	  Dragon application
```

## package/lion/Config.in
```kconfig
config BR2_PACKAGE_LION
	bool "lion"
	depends on BR2_PACKAGE_HOST_RUSTC_TARGET_ARCH_SUPPORTS
	select BR2_PACKAGE_HOST_RUSTC
	select BR2_PACKAGE_ZEROMQ
	select BR2_PACKAGE_PROTOBUF
	select BR2_PACKAGE_PROTOBUF_C
	help
	  Lion application
```

## package/phoenix/Config.in
```kconfig
config BR2_PACKAGE_PHOENIX
	bool "phoenix"
	depends on BR2_PACKAGE_HOST_RUSTC_TARGET_ARCH_SUPPORTS
	select BR2_PACKAGE_HOST_RUSTC
	select BR2_PACKAGE_ZEROMQ
	select BR2_PACKAGE_OPENSSL
	select BR2_PACKAGE_PROTOBUF
	select BR2_PACKAGE_PROTOBUF_C
	select BR2_PACKAGE_PAHO_MQTT_C
	help
	  Phoenix application
```

## package/turtle/Config.in
```kconfig
config BR2_PACKAGE_TURTLE
	bool "turtle"
	select BR2_PACKAGE_BOOST
	select BR2_PACKAGE_BOOST_SYSTEM
	select BR2_PACKAGE_ZEROMQ
	select BR2_PACKAGE_PROTOBUF
	select BR2_PACKAGE_PROTOBUF_C
	help
	  Turtle application
```
